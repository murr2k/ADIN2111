## drivers/net/ethernet/adi/Kconfig
```kconfig
# SPDX-License-Identifier: GPL-2.0-only
#
# Analog Devices network device configuration
#

config NET_VENDOR_ADI
	bool "Analog Devices devices"
	default y
	depends on SPI
	help
	  If you have a network (Ethernet) card belonging to this class, say Y.

	  Note that the answer to this question doesn't directly affect the
	  kernel: saying N will just cause the configurator to skip all
	  the questions about Analog Devices devices. If you say Y, you will
	  be asked for your specific card in the following questions.

if NET_VENDOR_ADI

config ADIN2111
	tristate "Analog Devices ADIN2111 MAC-PHY"
	depends on SPI
	select REGMAP_SPI
	select PHYLIB
	help
	  Say Y here if you want to use the Analog Devices ADIN2111
	  dual port industrial Ethernet switch with integrated PHY.

	  This driver supports both switch mode (two separate network
	  interfaces) and dual MAC mode (single network interface).

	  To compile this driver as a module, choose M here: the module
	  will be called adin2111.

endif # NET_VENDOR_ADI
```

## drivers/net/ethernet/adi/adin2111/Kconfig
```kconfig
# SPDX-License-Identifier: GPL-2.0+
# ADIN2111 Driver Configuration
# Author: Murray Kopit
# Date: August 11, 2025

config ADIN2111
	tristate "Analog Devices ADIN2111 Dual-Port Ethernet Switch"
	depends on SPI
	select REGMAP_SPI
	select PHYLIB
	select CRC32
	help
	  This driver supports the Analog Devices ADIN2111 dual-port
	  10BASE-T1L Ethernet switch with integrated PHYs and SPI interface.

	  The driver can operate in two modes:
	  - Switch mode: Hardware switching between ports (default)
	  - Dual MAC mode: Separate network interfaces for each port

	  To compile this driver as a module, choose M here. The module
	  will be called adin2111.

config ADIN2111_SWITCH_MODE
	bool "Enable hardware switch mode by default"
	depends on ADIN2111
	default y
	help
	  Enable hardware switch mode by default. In this mode, the
	  ADIN2111 performs autonomous switching between its two ports
	  without host involvement, reducing CPU load and latency.

	  This can be overridden via module parameter or device tree.

config ADIN2111_DEBUG
	bool "Enable debug messages"
	depends on ADIN2111
	help
	  Enable verbose debug messages for the ADIN2111 driver.
	  This is useful for development and troubleshooting.
```

## qemu-old-backup/hw/net/Kconfig
```kconfig
# ADIN2111 Configuration
# Copyright (c) 2025 Murray Kopit <murr2k@gmail.com>

config ADIN2111
    bool
    default y if SSI
    depends on SSI
    help
      ADIN2111 Dual-Port 10BASE-T1L Ethernet Switch/PHY
      
      This enables emulation of the Analog Devices ADIN2111
      dual-port Ethernet switch with integrated PHYs.
      
      Features:
      - SPI slave interface
      - Dual 10BASE-T1L PHY ports
      - Internal L2 switch
      - Cut-through and store-and-forward modes
      - MAC filtering (16 entries)
      - IEEE 1588 timestamping support
      - Diagnostics and statistics
```
